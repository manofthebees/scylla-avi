## config/boards/shields/flounderV2/Kconfig.defconfig
```kconfig
if SHIELD_SCYLLA-AVI_LEFT
 
config ZMK_KEYBOARD_NAME
    default "scylla-avi"
 
config ZMK_SPLIT_ROLE_CENTRAL
    default y
 
endif
 
if SHIELD_SCYLLA-AVI_LEFT || SHIELD_SCYLLA-AVI_RIGHT
 
config ZMK_SPLIT
    default y
 
endif
```

## config/boards/shields/flounderV2/Kconfig.shield
```kconfig
config SHIELD_SCYLLA-AVI_LEFT
    def_bool $(shields_list_contains,scylla-avi_left)
    select SHIELD_SCYLLA-AVI

config SHIELD_SCYLLA-AVI_RIGHT
    def_bool $(shields_list_contains,scylla-avi_right)
    select SHIELD_SCYLLA-AVI
```
